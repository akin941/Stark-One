## components/stark_app/Kconfig.stark
```kconfig
# stark_app options, shown in the single STARK menu: main/Kconfig.projbuild
# sources this file (ARCHITECTURE.md §9).

config STARK_APP_WORKER_STACK
    int "App worker stack (bytes)"
    range 2048 16384
    default 4096
    help
        Stack of the running app's one background worker (a static slot:
        reserved at build time, whether or not an app uses it).
        ARCHITECTURE.md §6.8, §8.

config STARK_APP_WORKER_PRIO
    int "App worker priority"
    range 1 4
    default 4
    help
        FreeRTOS priority of the worker task; below the UI task's 5 so a
        busy worker never starves the UI.

config STARK_APP_WORKER_JOIN_MS
    int "App worker join timeout (ms)"
    range 100 10000
    default 1000
    help
        How long stopping an app waits for its worker to return before the
        task is deleted anyway (a contract violation, logged and counted).
```

## components/stark_display/Kconfig
```kconfig
menu "STARK"

    config STARK_DISPLAY_BAND_H
        int "Display render band height (lines)"
        default 40
        help
            Height of one DMA render band, in scanlines. Sizes the band buffer
            and the SPI2 max transfer (320 * STARK_DISPLAY_BAND_H * 2 bytes,
            default 25600, set by stark_board_init()). ARCHITECTURE.md §6.5, §9.

    config STARK_DISPLAY_SPI_HZ
        int "Display SPI clock (Hz)"
        default 40000000
        help
            SPI2 clock for the panel. 40 MHz is the target for the production
            PCB (ARCHITECTURE.md §9, HARDWARE.md §2.3). On a breadboard set
            20000000 (20 MHz): long jumper wires will not survive 40 MHz. The
            simulator runs at either.

    config STARK_DISPLAY_SWAP_XY
        bool "Swap X/Y (landscape)"
        default y
        help
            With the two mirror settings this selects the rotation. The
            defaults (swap only, no mirror: MADCTL MV, the usual ILI9341
            "rotation 1") give an upright 320x240 landscape image on a
            standard 2.8" module and on the simulated ILI9341, whose part is
            rotated 90 degrees in diagram.json for that reason. A mirror
            setting that does not match produces a transposed image, which no
            physical rotation of the panel can correct.

    config STARK_DISPLAY_MIRROR_X
        bool "Mirror X"
        default n

    config STARK_DISPLAY_MIRROR_Y
        bool "Mirror Y"
        default n

    config STARK_DISPLAY_BGR
        bool "Panel colour order is BGR"
        default y
        help
            If the red test bar shows up blue, this default is wrong for the
            panel: fix it here, never by swapping colours in stark_gfx.

    config STARK_DISPLAY_INVERT
        bool "Invert colours"
        default n

endmenu
```

## components/stark_input/Kconfig
```kconfig
menu "STARK"

    config STARK_INPUT_POLL_MS
        int "Key sampling period (ms)"
        default 5
        help
            Period of the esp_timer that samples the six key GPIOs and runs
            the debounce/repeat core (components/stark_input). The debounce,
            long-press and repeat timings are separate constants in
            input_core.h and do not depend on this. ARCHITECTURE.md §6.6, §9.

endmenu
```

## components/stark_storage/Kconfig.stark
```kconfig
# stark_storage options, shown in the single STARK menu: main/Kconfig.projbuild
# sources this file (ARCHITECTURE.md §9). TASKS.md STARK-0201.

config STARK_STORAGE_RETRY_MS
    int "Storage: mount retry period (ms)"
    range 1000 60000
    default 3000
    help
        While no usable card is mounted, a mount is attempted this often.
        There is no card-detect pin (ADR-0018 §5): polling is how an
        inserted card is found.

config STARK_STORAGE_PROBE_MS
    int "Storage: presence probe period (ms)"
    range 250 10000
    default 1000
    help
        While a card is mounted, it is asked (CMD13) this often whether it
        is still there; an I/O error also triggers a probe at once.

config STARK_STORAGE_TASK_PRIO
    int "Storage task priority"
    range 1 4
    default 2
    help
        Below the app worker (4) and the UI task (5).

config STARK_STORAGE_TASK_STACK
    int "Storage task stack (bytes)"
    range 3072 8192
    default 4096

config STARK_STORAGE_LOG_FLUSH_MS
    int "Storage: log file flush period (ms)"
    range 250 10000
    default 1000
    help
        While a card is mounted, the captured console lines
        (STARK_LOG_RING_BYTES) are appended to logs/stark.log this often.
        A removal loses at most one period's lines. Capture off (ring 0)
        means no log file.

config STARK_STORAGE_LOG_FILE_KB
    int "Storage: log file size before rotation (kB)"
    range 4 1024
    default 64

config STARK_STORAGE_LOG_FILES
    int "Storage: log files kept (stark.log + older)"
    range 1 8
    default 4
    help
        The log directory never holds more than this many files of
        STARK_STORAGE_LOG_FILE_KB each, plus one flush.
```

## components/stark_ui/Kconfig
```kconfig
menu "STARK"

    config STARK_UI_TARGET_FPS
        int "UI frame cap (frames per second)"
        default 30
        help
            The UI task renders at most once per tick and, after a tick,
            sleeps on stark_event_wait() for the rest of the 1/FPS frame
            unless an event arrives first. ARCHITECTURE.md §9.

endmenu
```
